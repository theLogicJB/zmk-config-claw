## config/boards/shields/claw/Kconfig.defconfig
```kconfig
if SHIELD_CLAW_LEFT

config ZMK_KEYBOARD_NAME
	default "Claw"

config ZMK_SPLIT_ROLE_CENTRAL
	default y

endif

if SHIELD_CLAW_LEFT || SHIELD_CLAW_RIGHT

config ZMK_SPLIT
	default y

endif
```

## config/boards/shields/claw/Kconfig.shield
```kconfig
config SHIELD_CLAW_LEFT
	def_bool $(shields_list_contains,claw_left)

config SHIELD_CLAW_RIGHT
	def_bool $(shields_list_contains,claw_right)
```
